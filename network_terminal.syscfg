/**
 * @cliArgs --board "/ti/boards/LP_EM_CC35X1" --rtos "freertos" --product "simplelink_wifi_sdk@10.10.01.08" --product "TOOLBOX@4.2.4"
 * @versions {"tool":"1.26.3+4558"}
 */

/**
 * Import the modules used in this configuration.
 */
const FreeRTOS              = scripting.addModule("/freertos/FreeRTOS");
const CryptoKeyKeyStore_PSA = scripting.addModule("/ti/drivers/CryptoKeyKeyStore_PSA");
const GPIO                  = scripting.addModule("/ti/drivers/GPIO");
const GPIO1                 = GPIO.addInstance();
const GPIO6                 = GPIO.addInstance();
const GPIO7                 = GPIO.addInstance();
const GPIO8                 = GPIO.addInstance();
const GPIO9                 = GPIO.addInstance();
const Power                 = scripting.addModule("/ti/drivers/Power");
const RNG                   = scripting.addModule("/ti/drivers/RNG", {}, false);
const RNG1                  = RNG.addInstance();
const UART2                 = scripting.addModule("/ti/drivers/UART2");
const UART21                = UART2.addInstance();
const UART22                = UART2.addInstance();
const Mem_cfg               = scripting.addModule("/ti/memoryconfig/MemoryConfigurator/Mem_cfg");
const Settings              = scripting.addModule("/ti/posix/freertos/Settings");

/**
 * Write custom configuration values to the imported modules.
 */
FreeRTOS.useTimeSlicing = true;
FreeRTOS.heapSize       = 0x00057000;

GPIO1.$hardware = system.deviceData.board.components.LED_RED;
GPIO1.$name     = "CONFIG_GPIO_LED_0";

GPIO6.$name     = "CONFIG_GPIO_LED_1";
GPIO6.$hardware = system.deviceData.board.components.LED_GREEN;

GPIO7.$name     = "CONFIG_GPIO_LED_2";
GPIO7.$hardware = system.deviceData.board.components.LED_BLUE;

GPIO8.$hardware = system.deviceData.board.components["BTN-1"];
GPIO8.$name     = "CONFIG_GPIO_BTN_0";
GPIO8.pull      = "Pull Up";

GPIO9.$name     = "CONFIG_GPIO_BTN_1";
GPIO9.$hardware = system.deviceData.board.components["BTN-2"];
GPIO9.pull      = "Pull Up";

RNG1.$name = "CONFIG_RNG_0";

UART21.$name                     = "CONFIG_UART2_0";
UART21.$hardware                 = system.deviceData.board.components.XDS110UART;
UART21.uart.dmaTxChannel.$assign = "DMA_CH2";
UART21.uart.dmaRxChannel.$assign = "DMA_CH3";

UART22.$name = "CONFIG_UART2_1";

Mem_cfg.flash_device_type = "IS25WJ032F";
Mem_cfg.ota               = false;

/**
 * Pinmux solution for unlocked pins/peripherals. This ensures that minor changes to the automatic solver in a future
 * version of the tool will not impact the pinmux you originally saw.  These lines can be completely deleted in order to
 * re-solve from scratch.
 */
GPIO1.gpioPin.$suggestSolution            = "boosterpack.31";
GPIO6.gpioPin.$suggestSolution            = "boosterpack.17";
GPIO7.gpioPin.$suggestSolution            = "boosterpack.36";
GPIO8.gpioPin.$suggestSolution            = "boosterpack.19";
GPIO9.gpioPin.$suggestSolution            = "boosterpack.40";
UART21.uart.$suggestSolution              = "UART1";
UART21.uart.txPin.$suggestSolution        = "GPIO5";
UART21.uart.rxPin.$suggestSolution        = "GPIO6";
UART22.uart.$suggestSolution              = "UART0";
UART22.uart.dmaTxChannel.$suggestSolution = "DMA_CH1";
UART22.uart.dmaRxChannel.$suggestSolution = "DMA_CH0";
UART22.uart.txPin.$suggestSolution        = "boosterpack.4";
UART22.uart.rxPin.$suggestSolution        = "boosterpack.3";
